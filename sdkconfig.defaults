## sdkconfig.defaults
```kconfig
# Project-wide SDK configuration for ESP32-S3-Touch-LCD-5
CONFIG_IDF_TARGET="esp32s3"

# ESP32-S3 Performance and Hardware configuration
CONFIG_ESP_DEFAULT_CPU_FREQ_MHZ_240=y
CONFIG_FREERTOS_HZ=1000

# Flash/PSRAM configuration
CONFIG_ESPTOOLPY_FLASHMODE_QIO=y
CONFIG_ESPTOOLPY_FLASHFREQ_80M=y
CONFIG_ESPTOOLPY_FLASHSIZE_16MB=y
CONFIG_SPIRAM=y
CONFIG_SPIRAM_MODE_OCT=y
CONFIG_IDF_EXPERIMENTAL_FEATURES=y
CONFIG_SPIRAM_SPEED_80M=y
CONFIG_SPIRAM_FETCH_INSTRUCTIONS=y
CONFIG_SPIRAM_RODATA=y
CONFIG_SPIRAM_MALLOC_ALWAYSINTERNAL=16384
CONFIG_ESP32S3_DATA_CACHE_LINE_64B=y
CONFIG_ESP32S3_DATA_CACHE_LINE_SIZE=64

# Console
CONFIG_ESP_CONSOLE_USB_SERIAL_JTAG=y

# Optimization
CONFIG_COMPILER_OPTIMIZATION_PERF=y

# LVGL configuration (recommended settings)
CONFIG_LV_MEM_CUSTOM=y
CONFIG_LV_MEMCPY_MEMSET_STD=y
CONFIG_LV_ATTRIBUTE_FAST_MEM=y
CONFIG_LV_COLOR_DEPTH_16=y
CONFIG_LV_COLOR_16_SWAP=n
CONFIG_LV_FONT_MONTSERRAT_20=y
CONFIG_LV_USE_LODEPNG=y
CONFIG_LV_USE_TJPGD=n
CONFIG_LV_USE_FS_FATFS=n
CONFIG_LV_USE_FS_STDIO=y
CONFIG_LV_FS_STDIO_LETTER=83
CONFIG_LV_FS_STDIO_PATH="/sdcard/"
CONFIG_LV_FS_STDIO_CACHE_SIZE=0
CONFIG_LV_CACHE_DEF_SIZE=4194304

# LVGL Logging
CONFIG_LV_USE_LOG=y
CONFIG_LV_LOG_LEVEL_INFO=y
CONFIG_LV_LOG_PRINTF=y

# Watchdog - Disabled for diagnostic
CONFIG_ESP_TASK_WDT_EN=n
CONFIG_ESP_INT_WDT=n
```
